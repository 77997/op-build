## openpower/configs/firestone_defconfig
```kconfig
BR2_powerpc64le=y
BR2_powerpc_power8=y
BR2_PACKAGE_HOST_LINUX_HEADERS_CUSTOM_6_12=y
BR2_BINUTILS_EXTRA_CONFIG_OPTIONS="--enable-targets=powerpc64-linux"
BR2_EXTRA_GCC_CONFIG_OPTIONS="--enable-targets=powerpc64-linux --disable-libsanitizer"
BR2_TOOLCHAIN_BUILDROOT_CXX=y
BR2_OPTIMIZE_S=y
BR2_TARGET_GENERIC_HOSTNAME="skiroot"
BR2_ROOTFS_DEVICE_CREATION_DYNAMIC_EUDEV=y
# BR2_PACKAGE_EUDEV_MODULE_LOADING is not set
# BR2_PACKAGE_EUDEV_ENABLE_HWDB is not set
BR2_GENERATE_LOCALE="en_US.UTF-8"
BR2_ROOTFS_OVERLAY="../openpower/overlay"
BR2_ROOTFS_POST_BUILD_SCRIPT="../openpower/scripts/fixup-target-var ../openpower/scripts/silence-init"
BR2_LINUX_KERNEL=y
BR2_LINUX_KERNEL_CUSTOM_VERSION=y
BR2_LINUX_KERNEL_CUSTOM_VERSION_VALUE="6.12.87"
BR2_LINUX_KERNEL_PATCH="$(BR2_EXTERNAL_OP_BUILD_PATH)/linux"
BR2_LINUX_KERNEL_USE_CUSTOM_CONFIG=y
BR2_LINUX_KERNEL_CUSTOM_CONFIG_FILE="$(BR2_EXTERNAL_OP_BUILD_PATH)/configs/linux/skiroot_defconfig"
BR2_LINUX_KERNEL_CONFIG_FRAGMENT_FILES="$(BR2_EXTERNAL_OP_BUILD_PATH)/configs/linux/skiroot-firestone.fragment"
BR2_LINUX_KERNEL_ZIMAGE_EPAPR=y
BR2_LINUX_KERNEL_XZ=y
BR2_LINUX_KERNEL_NEEDS_HOST_OPENSSL=y
BR2_PACKAGE_BUSYBOX_CONFIG_FRAGMENT_FILES="$(BR2_EXTERNAL_OP_BUILD_PATH)/configs/busybox.fragment"
BR2_PACKAGE_BUSYBOX_SHOW_OTHERS=y
BR2_PACKAGE_IPMITOOL=y
BR2_PACKAGE_PCIUTILS=y
BR2_PACKAGE_DROPBEAR=y
# BR2_PACKAGE_DROPBEAR_SERVER is not set
BR2_PACKAGE_ETHTOOL=y
BR2_PACKAGE_SUDO=y
# BR2_PACKAGE_LVM2_STANDARD_INSTALL is not set
BR2_PACKAGE_PETITBOOT=y
BR2_PACKAGE_PETITBOOT_GETTY_PORT="hvc* tty0 ttyS*"
BR2_PACKAGE_PETITBOOT_MTD=y
BR2_TARGET_ROOTFS_CPIO_XZ=y
BR2_TARGET_ROOTFS_INITRAMFS=y
BR2_OPENPOWER_PLATFORM=y
BR2_OPENPOWER_POWER8=y
BR2_ALTERNATE_GCC_VERSION="6.5.0"
BR2_ALTERNATE_GCC_COMPILER_ONLY=y
BR2_HOSTBOOT_P8_CONFIG_FILE="firestone.config"
BR2_OPENPOWER_MACHINE_XML_GITHUB_PROJECT_VALUE="firestone-xml"
BR2_OPENPOWER_MACHINE_XML_VERSION="9df12d2653f2fbcae043d0e8effadb9aa5b84694"
BR2_OPENPOWER_MACHINE_XML_FILENAME="firestone.xml"
BR2_OPENPOWER_SYSTEM_XML_FILENAME="FIRESTONE_hb.system.xml"
BR2_OPENPOWER_MRW_XML_FILENAME="FIRESTONE_hb.mrw.xml"
BR2_OPENPOWER_BIOS_XML_FILENAME="FIRESTONE_bios.xml"
BR2_OPENPOWER_PNOR_XML_LAYOUT_FILENAME="firestoneLayoutWithGoldenSide.xml"
BR2_OPENPOWER_CONFIG_NAME="firestone"
BR2_OPENPOWER_PNOR_FILENAME="firestone.pnor"
BR2_HOSTBOOT_BINARY_SBE_FILENAME="venice_sbe.img.ecc"
BR2_HOSTBOOT_BINARY_SBEC_FILENAME="centaur_sbec_pad.img.ecc"
BR2_HOSTBOOT_BINARY_WINK_FILENAME="p8.ref_image.hdr.bin.ecc"
BR2_IMA_CATALOG_FILENAME="ima_catalog.bin"
BR2_OPENPOWER_TARGETING_BIN_FILENAME="FIRESTONE_HB.targeting.bin"
BR2_OPENPOWER_TARGETING_ECC_FILENAME="FIRESTONE_HB.targeting.bin.ecc"
BR2_CAPP_UCODE_BIN_FILENAME="cappucode.bin"
BR2_SKIBOOT_CUSTOM_VERSION=y
BR2_SKIBOOT_CUSTOM_VERSION_VALUE="0c32c70b99485ae0e6ca6922923bcb7e8d2d62a2"
BR2_SKIBOOT_EXTRA_MAKE_OPTS="CONFIG_P8=1 CONFIG_FSP=0 CONFIG_PLDM=0"
BR2_PACKAGE_LOADKEYS=y
BR2_IMA_CATALOG_DTS="POWER8"
```

## openpower/package/alternate-gcc/Config.in
```kconfig
config BR2_PACKAGE_ALTERNATE_GCC
		bool "alternate-gcc"
		select BR2_PACKAGE_ALTERNATE_BINUTILS
		help
		  Build gcc for an Alternate Toolchain, for use in
		  certain packages.


if BR2_PACKAGE_ALTERNATE_GCC

config BR2_ALTERNATE_GCC_VERSION
		string "Alternate gcc version"
		default "8.4.0"

config BR2_ALTERNATE_GCC_EXTRA_CONFIG_OPTIONS
		string "Extra configure options for Alternate Toolchain GCC"
		default BR2_EXTRA_GCC_CONFIG_OPTIONS
		help
		  Any extra options to the Alternate Toolchain's gcc configure script
		  The default is taken from EXTRA_GCC_CONFIG_OPTIONS

config BR2_ALTERNATE_GCC_COMPILER_ONLY
		bool "Build only the Alternate Toolchain compiler"
		default n
		help
		  Build and install only the compiler proper (make all-gcc and
		  make install-gcc), without libgcc, libstdc++ or any other
		  target library. This suits packages that build freestanding
		  code and never link the compiler's libraries, and allows an
		  older GCC whose target libraries no longer build against the
		  current C library.

endif
```

## openpower/package/hostboot-p8/Config.in
```kconfig
config BR2_PACKAGE_HOSTBOOT_P8
        bool "hostboot-p8"
        default y if (BR2_OPENPOWER_POWER8)
        select BR2_CPP
        select BR2_PACKAGE_ALTERNATE_GCC
        help
            Project to build the hostboot firmware codebase for POWER8.
            It is always built with the Alternate Toolchain: its code
            builds with -Werror and has never been built with a GCC
            newer than 6, and its host tools need the libbfd API that
            binutils 2.34 removed.

if BR2_PACKAGE_HOSTBOOT_P8

config BR2_HOSTBOOT_P8_CONFIG_FILE
        string "Hostboot configuration file for compilation"
        default default
        help
            String used to define hw specific make config file

endif
```
